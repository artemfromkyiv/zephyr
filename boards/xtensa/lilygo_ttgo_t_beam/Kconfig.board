## boards/xtensa/lilygo_ttgo_t_beam/Kconfig.board
```kconfig
# Lilygo TTGo T beam board configuration

# SPDX-License-Identifier: Apache-2.0

config BOARD_LILYGO_TTGO_T_BEAM
	bool "LILYGO TTGO T-Beam Board"
	depends on SOC_ESP32
```

## boards/xtensa/lilygo_ttgo_t_beam/Kconfig.defconfig
```kconfig
# LILYGO TTGO T BEAM board configuration

config BOARD
	default "lilygo_ttgo_t_beam"
	depends on BOARD_LILYGO_TTGO_T_BEAM

config ENTROPY_GENERATOR
	default y

config ENTROPY_ESP32_RNG
	default y if ENTROPY_GENERATOR
```
